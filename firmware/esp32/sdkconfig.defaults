## firmware/esp32/sdkconfig.defaults
```kconfig
# firmware/esp32/sdkconfig.defaults

# BLE via NimBLE, observer role only.
CONFIG_BT_ENABLED=y
CONFIG_BT_NIMBLE_ENABLED=y
CONFIG_BT_CONTROLLER_ONLY=n
CONFIG_BT_NIMBLE_ROLE_OBSERVER=y
CONFIG_BT_NIMBLE_ROLE_CENTRAL=y
CONFIG_BT_NIMBLE_ROLE_PERIPHERAL=n
CONFIG_BT_NIMBLE_ROLE_BROADCASTER=n
CONFIG_BT_NIMBLE_MAX_CONNECTIONS=3
CONFIG_BT_NIMBLE_ATT_PREFERRED_MTU=517
CONFIG_BT_NIMBLE_HOST_TASK_STACK_SIZE=5120
CONFIG_BT_NIMBLE_LOG_LEVEL_INFO=y

# NVS for counter, event log and the provisioned signing key.
CONFIG_NVS_ENCRYPTION=y

# HTTPS reporting.
CONFIG_ESP_TLS_USING_MBEDTLS=y
CONFIG_MBEDTLS_HARDWARE_SHA=y
CONFIG_ESP_HTTP_CLIENT_ENABLE_HTTPS=y

# Stacks. The report task does TLS, so it needs room.
CONFIG_ESP_MAIN_TASK_STACK_SIZE=6144
CONFIG_ESP_SYSTEM_EVENT_TASK_STACK_SIZE=3072
CONFIG_FREERTOS_HZ=1000

# C++17, exceptions off.
CONFIG_COMPILER_CXX_EXCEPTIONS=n
CONFIG_COMPILER_CXX_RTTI=n
CONFIG_COMPILER_OPTIMIZATION_SIZE=y

CONFIG_PARTITION_TABLE_CUSTOM=y
CONFIG_PARTITION_TABLE_CUSTOM_FILENAME="partitions.csv"
```
